## esp32-projects/components/bsp/Kconfig
```kconfig
menu "LAAP BSP"

    choice BSP_BOARD_SEL
        prompt "Board Selection"
        default BSP_BOARD_S3_ROUND_GC9A01
        help
            选择硬件板子。应用代码不依赖这个选择——
            换板子只改这里，业务代码一行都不用动。

        config BSP_BOARD_S3_ROUND_GC9A01
            bool "ESP32-S3 + GC9A01 圆屏宠物板（自组，¥120）"
        config BSP_BOARD_S3_KORVO2
            bool "ESP32-S3-Korvo-2（乐鑫官方语音板）"
        config BSP_BOARD_S3_EYE
            bool "ESP32-S3-EYE（摄像头视觉板）"
        config BSP_BOARD_P4_LCD
            bool "ESP32-P4 + LCD（大屏终端）"
        config BSP_BOARD_GENERIC
            bool "通用/自定义板（引脚在 menuconfig 里填）"
    endchoice

    config BSP_BOARD
        string
        default "s3_round_gc9a01" if BSP_BOARD_S3_ROUND_GC9A01
        default "s3_korvo2"       if BSP_BOARD_S3_KORVO2
        default "s3_eye"          if BSP_BOARD_S3_EYE
        default "p4_lcd"          if BSP_BOARD_P4_LCD
        default "generic"         if BSP_BOARD_GENERIC

    config BSP_I2C_PORT
        int "I2C port number"
        default 0

    config BSP_I2C_SPEED
        int "I2C clock (Hz)"
        default 400000

    menu "Generic Board Pins"
        depends on BSP_BOARD_GENERIC

        config BSP_GEN_LCD_SCLK
            int "LCD SCLK" 
            default 12
        config BSP_GEN_LCD_MOSI
            int "LCD MOSI"
            default 11
        config BSP_GEN_LCD_CS
            int "LCD CS"
            default 10
        config BSP_GEN_LCD_DC
            int "LCD DC"
            default 9
        config BSP_GEN_LCD_RST
            int "LCD RST"
            default 8
        config BSP_GEN_LCD_BL
            int "LCD Backlight"
            default 7
        config BSP_GEN_SERVO0
            int "Servo 0 (pan)"
            default 4
        config BSP_GEN_SERVO1
            int "Servo 1 (tilt)"
            default 5
        config BSP_GEN_TOUCH
            int "Touch input"
            default 6
        config BSP_GEN_I2S_BCLK
            int "I2S BCLK"
            default 18
        config BSP_GEN_I2S_LRCK
            int "I2S LRCK"
            default 17
        config BSP_GEN_I2S_DOUT
            int "I2S DOUT (speaker)"
            default 19
        config BSP_GEN_I2S_DIN
            int "I2S DIN (mic)"
            default 16
    endmenu

endmenu
```

## esp32-projects/components/lbp/Kconfig
```kconfig
menu "LAAP LBP"

    config LBP_CAN_TX_GPIO
        int "TWAI TX GPIO"
        default 4
        help
          CAN 收发器 TJA1050 的 TXD 接这个脚。

    config LBP_CAN_RX_GPIO
        int "TWAI RX GPIO"
        default 5

    config LBP_BITRATE
        int "CAN bitrate (bps)"
        default 1000000
        help
          ESP32 TWAI 只支持 CAN 2.0B，最高 1 Mbps。
          需要 CAN FD 必须外挂 MCP2518FD（SPI 接）。

    config LBP_NODE_ADDR
        int "本节点 CAN 地址（从站模式）"
        default 16
        range 2 254

    config LBP_MOUNT_PORT
        int "本节点挂载端口（0-7，从 ID 线读）"
        default 0
        range 0 7

endmenu
```

## esp32-projects/projects/pet_robot/firmware/main/Kconfig.projbuild
```kconfig
menu "LAAP Pet"

    config PET_WIFI_SSID
        string "WiFi SSID"
        default "LAAP-Office"

    config PET_WIFI_PASS
        string "WiFi Password"
        default "laap2026"

    config PET_WS_HOST
        string "LAAP host (电脑 IP)"
        default "192.168.1.100"

    config PET_WS_PORT
        int "LAAP port"
        default 8765

endmenu
```

## esp32-projects/tests/lbp_selftest/sdkconfig.defaults
```kconfig
# LBP 自检固件
# 纯逻辑测试，不需要任何外设

CONFIG_IDF_TARGET="esp32s3"

# 串口输出（模拟器要靠这个读结果）
CONFIG_ESP_CONSOLE_UART_DEFAULT=y
CONFIG_ESP_CONSOLE_UART_BAUDRATE=115200

# 浮点格式化要开（printf %f）
CONFIG_NEWLIB_NANO_FORMAT=n

# 关掉看门狗干扰（自检可能短暂阻塞）
CONFIG_ESP_TASK_WDT_INIT=n
CONFIG_ESP_INT_WDT=n

# 日志精简，只留我们自己的 printf
CONFIG_LOG_DEFAULT_LEVEL_WARN=y
CONFIG_BOOTLOADER_LOG_LEVEL_WARN=y

# 主任务栈加大：自检里有较多局部缓冲，默认 3584 字节偏紧
CONFIG_ESP_MAIN_TASK_STACK_SIZE=8192
```
